## sdkconfig.defaults
```kconfig
CONFIG_SPIRAM=y
CONFIG_SPIRAM_MODE_OCT=y
CONFIG_SPIRAM_TYPE_AUTO=y
CONFIG_SPIRAM_SIZE=8388608
CONFIG_ESP32S3_SPIRAM_SUPPORT=y
CONFIG_ESP32S3_DEFAULT_PSRAM_CLK_IO=30
CONFIG_ESP32S3_DEFAULT_PSRAM_CS_IO=26
```
